## config/Boards/Shields/kiwi/Kconfig.defconfig
```kconfig
# Unable to use interrupts as the same pin number is used
# across A & B controllers, and STM32F303CCT6 can't enable
# interrutps for multiple controllers for the same "line"
# for the external interrupts.


if SHIELD_KIWI

config ZMK_KEYBOARD_NAME
    default "Kiwi"

endif

if SHIELD_KIWI_LEFT

config ZMK_SPLIT_BLE_ROLE_CENTRAL
    default y

endif

if SHIELD_KIWI_LEFT || SHIELD_KIWI_RIGHT

config ZMK_SPLIT
    default y

endif
```

## config/Boards/Shields/kiwi/Kconfig.shield
```kconfig
# Copyright (c) 2020 Pete Johanson
# SPDX-License-Identifier: MIT

config SHIELD_KIWI
    def_bool $(shields_list_contains,kiwi)

config SHIELD_KIWI_LEFT
	def_bool $(shields_list_contains,kiwi_left)

config SHIELD_KIWI_RIGHT
	def_bool $(shields_list_contains,kiwi_right)
```

## config/boards/shields/kiwi/Kconfig.defconfig
```kconfig
if SHIELD_KIWI_LEFT

config ZMK_KEYBOARD_NAME
    default "kiwi"

config ZMK_SPLIT_BLE_ROLE_CENTRAL
    default y

endif

if SHIELD_KIWI_LEFT || SHIELD_KIWI_RIGHT

config ZMK_SPLIT
    default y

endif
```

## config/boards/shields/kiwi/Kconfig.shield
```kconfig
# Copyright (c) 2020 Pete Johanson
# SPDX-License-Identifier: MIT

config SHIELD_KIWI_LEFT
	def_bool $(shields_list_contains,kiwi_left)

config SHIELD_KIWI_RIGHT
	def_bool $(shields_list_contains,kiwi_right)
```

## config/west.yml
```yaml
manifest:
  remotes:
    - name: MaxwellMiddendorf
      url-base: https://github.com/MaxwellMiddendorf
  projects:
    - name: zmk
      remote: MaxwellMiddendorf
      revision: main
      import: app/west.yml
  self:
    path: config
```
